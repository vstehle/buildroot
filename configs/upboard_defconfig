## configs/upboard_defconfig
```kconfig
BR2_x86_64=y
BR2_x86_atom=y
BR2_CCACHE=y
BR2_OPTIMIZE_2=y
BR2_KERNEL_HEADERS_4_8=y
BR2_TOOLCHAIN_BUILDROOT_GLIBC=y
BR2_GLIBC_VERSION_2_24=y
BR2_BINUTILS_VERSION_2_27_X=y
BR2_GCC_VERSION_6_X=y
BR2_TOOLCHAIN_BUILDROOT_CXX=y
BR2_ROOTFS_DEVICE_CREATION_DYNAMIC_EUDEV=y
BR2_LINUX_KERNEL=y
BR2_LINUX_KERNEL_DEFCONFIG="x86_64"
BR2_PACKAGE_LINUX_TOOLS_PERF=y
BR2_PACKAGE_LINUX_TOOLS_TURBOSTAT=y
BR2_PACKAGE_BUSYBOX_SHOW_OTHERS=y
BR2_PACKAGE_DHRYSTONE=y
BR2_PACKAGE_GDB=y
BR2_PACKAGE_GDB_DEBUGGER=y
BR2_PACKAGE_GDB_TUI=y
BR2_PACKAGE_LMBENCH=y
BR2_PACKAGE_MCELOG=y
BR2_PACKAGE_PV=y
BR2_PACKAGE_RAMSMP=y
BR2_PACKAGE_RT_TESTS=y
BR2_PACKAGE_STRACE=y
BR2_PACKAGE_STRESS=y
BR2_PACKAGE_TRACE_CMD=y
BR2_PACKAGE_WHETSTONE=y
BR2_PACKAGE_BINUTILS=y
BR2_PACKAGE_ACPID=y
BR2_PACKAGE_CPUID=y
BR2_PACKAGE_DMIDECODE=y
BR2_PACKAGE_EDID_DECODE=y
BR2_PACKAGE_EEPROG=y
BR2_PACKAGE_I2C_TOOLS=y
BR2_PACKAGE_I7Z=y
BR2_PACKAGE_IUCODE_TOOL=y
BR2_PACKAGE_MEMTESTER=y
BR2_PACKAGE_MSR_TOOLS=y
BR2_PACKAGE_POWERTOP=y
BR2_PACKAGE_READ_EDID=y
BR2_PACKAGE_RNG_TOOLS=y
BR2_PACKAGE_USBUTILS=y
BR2_PACKAGE_ELFUTILS=y
BR2_PACKAGE_LIBUNWIND=y
BR2_PACKAGE_SLANG=y
BR2_PACKAGE_COREUTILS=y
BR2_PACKAGE_IRQBALANCE=y
BR2_PACKAGE_NCDU=y
BR2_PACKAGE_PSMISC=y
BR2_PACKAGE_SYSKLOGD=y
BR2_PACKAGE_TAR=y
BR2_TARGET_ROOTFS_CPIO=y
BR2_TARGET_ROOTFS_CPIO_GZIP=y
BR2_TARGET_GRUB2=y
BR2_TARGET_GRUB2_X86_64_EFI=y
BR2_PACKAGE_HOST_MKE2IMG=y
```

## configs/wandboard_defconfig
```kconfig
# architecture
BR2_arm=y
BR2_cortex_a9=y

BR2_CCACHE=y
BR2_CCACHE_DIR="/exported/buildbot/ccache-vincent"

# Lock to 3.10.17 headers
BR2_KERNEL_HEADERS_VERSION=y
BR2_DEFAULT_KERNEL_VERSION="3.10.17"
BR2_PACKAGE_HOST_LINUX_HEADERS_CUSTOM_3_10=y
BR2_GCC_VERSION_4_7_X=y

# system
BR2_TARGET_GENERIC_GETTY_PORT="ttymxc0"

# kernel
BR2_LINUX_KERNEL=y
BR2_LINUX_KERNEL_CUSTOM_GIT=y
BR2_LINUX_KERNEL_CUSTOM_REPO_URL="git://github.com/wandboard-org/linux.git"
# Branch wandboard_imx_3.10.17_1.0.0_ga, as of 2-Sep-2014.
BR2_LINUX_KERNEL_CUSTOM_REPO_VERSION="8e8131901542e472ac37eda811a4aa633a105fad"
BR2_LINUX_KERNEL_DEFCONFIG="wandboard"
BR2_LINUX_KERNEL_UIMAGE_LOADADDR="0x10008000"
BR2_LINUX_KERNEL_DTS_SUPPORT=y
BR2_LINUX_KERNEL_INTREE_DTS_NAME="imx6dl-wandboard"
BR2_LINUX_KERNEL_INSTALL_TARGET=y

# filesystem
BR2_TARGET_ROOTFS_EXT2=y
BR2_TARGET_ROOTFS_EXT2_4=y

# bootloader
BR2_TARGET_UBOOT=y
BR2_TARGET_UBOOT_BOARDNAME="wandboard_dl"
BR2_TARGET_UBOOT_FORMAT_CUSTOM=y
BR2_TARGET_UBOOT_FORMAT_CUSTOM_NAME="u-boot.imx"
BR2_TARGET_UBOOT_ENVIMAGE=y
BR2_TARGET_UBOOT_ENVIMAGE_SOURCE="board/wandboard/uboot-env.txt"
BR2_TARGET_UBOOT_ENVIMAGE_SIZE="0x2000"
```

## package/a3700-utils-marvell/Config.in
```kconfig
config BR2_PACKAGE_A3700_UTILS_MARVELL
	bool "a3700-utils-marvell"
	depends on BR2_aarch64
	help
	  https://github.com/MarvellEmbeddedProcessors/a3700-utils-marvell/
```

## package/a3700-utils-marvell/Config.in.host
```kconfig
config BR2_PACKAGE_HOST_A3700_UTILS_MARVELL
	bool "host a3700-utils-marvell"
	help
	  https://github.com/MarvellEmbeddedProcessors/a3700-utils-marvell/
```

## package/cpuid/Config.in
```kconfig
config BR2_PACKAGE_CPUID
	bool "cpuid"
	depends on BR2_i386 || BR2_x86_64
	help
	  cpuid dumps detailed information about the CPU(s) gathered from
	  the CPUID instruction, and also determines the exact model of CPU(s).
	  It supports Intel, AMD, and VIA CPUs, as well as older Transmeta,
          Cyrix, UMC, NexGen, Rise, and SiS CPUs.
```

## package/cryptopp/Config.in
```kconfig
config BR2_PACKAGE_CRYPTOPP
	bool "cryptopp"
	depends on BR2_INSTALL_LIBSTDCPP
	depends on !BR2_STATIC_LIBS
	depends on BR2_USE_WCHAR
	help
	  A free C++ class library of cryptographic schemes

comment "cryptopp needs a toolchain w/ C++, dynamic library, wchar"
	depends on !BR2_INSTALL_LIBSTDCPP || BR2_STATIC_LIBS || \
		!BR2_USE_WCHAR

if BR2_PACKAGE_CRYPTOPP

config BR2_PACKAGE_CRYPTOPP_DO_NOT_BUILD
	bool "cryptopp do not build"
	help
	  TODO

endif
```

## package/custom/cpuburn/Config.in
```kconfig
config BR2_PACKAGE_CPUBURN
	bool "cpuburn"
	depends on BR2_arm
	help
	  This is cpuburn for ARM Cortex-A[89].
```

## package/dos2unix/Config.in
```kconfig
config BR2_PACKAGE_DOS2UNIX
	bool "dos2unix"
	help
	  Dos2Unix text file format converters

	  http://waterlan.home.xs4all.nl/dos2unix.html
```

## package/dtc/Config.in.host
```kconfig
config BR2_PACKAGE_HOST_DTC
	bool "host dtc"
	help
	  The Device Tree Compiler, dtc, takes as input a device-tree in
	  a given format and outputs a device-tree in another format.

	  Install host tools: dtc, convert-dtsv0, fdtdump, fdtget and fdtput.

	  https://git.kernel.org/cgit/utils/dtc/dtc.git

if BR2_PACKAGE_HOST_DTC

config BR2_PACKAGE_HOST_DTC_INSTALL_LIBS
	bool "host dtc install libraries"
	help
	  TODO!

endif
```

## package/efitools/Config.in.host
```kconfig
config BR2_PACKAGE_HOST_EFITOOLS
	bool "host efitools"
	help
	  EFI tools.

	  https://git.kernel.org/pub/scm/linux/kernel/git/jejb/efitools.git/
```

## package/gcab/Config.in.host
```kconfig
config BR2_PACKAGE_HOST_GCAB
	bool "host gcab"
	help
          https://gitlab.gnome.org/GNOME/gcab
```

## package/glibc/Config.in
```kconfig
if BR2_TOOLCHAIN_BUILDROOT_EGLIBC

# For legal-info
config BR2_PACKAGE_EGLIBC
	bool
	default y

choice
	prompt "eglibc version"
	default BR2_EGLIBC_VERSION_2_18

config BR2_EGLIBC_VERSION_2_18
	bool "2.18-svnr23787"

config BR2_EGLIBC_VERSION_2_19
	bool "2.19-svnr25243"
	# Build breakage
	depends on !BR2_powerpc_SPE

endchoice

endif

if BR2_TOOLCHAIN_BUILDROOT_GLIBC

# For legal-info
config BR2_PACKAGE_GLIBC
	bool
	default y

choice
	prompt "glibc version"
	default BR2_GLIBC_VERSION_OPENRISC if BR2_openrisc
	default BR2_GLIBC_VERSION_2_19

config BR2_GLIBC_VERSION_2_19
	bool "2.19"

config BR2_GLIBC_VERSION_2_20
	bool "2.20"

config BR2_GLIBC_VERSION_OPENRISC
	bool "openrisc"

endchoice

endif

config BR2_GLIBC_VERSION_STRING
	string
	default "2.18-svnr23787" if BR2_EGLIBC_VERSION_2_18
	default "2.19-svnr25243" if BR2_EGLIBC_VERSION_2_19
	default "2.19" if BR2_GLIBC_VERSION_2_19
	default "2.20" if BR2_GLIBC_VERSION_2_20
	default "a983927e76908dd9d6ba9ecbd9651c48a56e5abc" if BR2_GLIBC_VERSION_OPENRISC
```

## package/hyperscan/Config.in
```kconfig
config BR2_PACKAGE_HYPERSCAN
	bool "hyperscan"
	depends on BR2_TOOLCHAIN_BUILDROOT_CXX
	select BR2_PACKAGE_BOOST
	select BR2_PACKAGE_HOST_RAGEL
	select BR2_PACKAGE_SQLITE
	select BR2_PACKAGE_LIBPCAP
	help
	  TODO!
```

## package/irrlicht/Config.in
```kconfig
config BR2_PACKAGE_IRRLICHT
	bool "irrlicht"
	depends on BR2_PACKAGE_HAS_LIBGL
	depends on BR2_PACKAGE_XORG7
	help
	  Irrlicht.
```

## package/mesa-demos/Config.in
```kconfig
menuconfig BR2_PACKAGE_MESA_DEMOS
	bool "Mesa 3D Demos"
	depends on BR2_PACKAGE_MESA3D
	select BR2_PACKAGE_GLEW
	help
	  Mesa 3D demos.

	  http://mesa3d.org
```

## package/minetest/Config.in
```kconfig
config BR2_PACKAGE_MINETEST
	bool "minetest"
	select BR2_PACKAGE_SQLITE
	select BR2_PACKAGE_LIBCURL
	select BR2_PACKAGE_FREETYPE
	select BR2_PACKAGE_LEVELDB
	select BR2_PACKAGE_XORG7
	select BR2_PACKAGE_MESA3D
	select BR2_PACKAGE_LIBJPEG
	select BR2_PACKAGE_BZIP2
	select BR2_PACKAGE_LIBPNG
	select BR2_PACKAGE_IRRLICHT
	help
	  Minetest.
```

## package/npe-firmware/Config.in
```kconfig
config BR2_PACKAGE_NPE_FIRMWARE
	bool "npe-firmware"
	depends on BR2_armeb	# Only relevant for IXP4XX
	help
	  Firmware for the IXP4XX NPE (Network Processor Engine).

	  For some IXP4XX platforms, this firmware is necessary even for basic
	  ethernet functionality. This is the case of e.g. the Linksys NSLU2.

	  This is the version of the firmware without crypto.

	  https://downloadcenter.intel.com/Detail_Desc.aspx?DwnldID=12954
```

## package/odp/Config.in
```kconfig
config BR2_PACKAGE_ODP
	bool "odp"
	depends on BR2_TOOLCHAIN_USES_GLIBC
	select BR2_PACKAGE_OPENSSL
	help
	  TODO!
```

## package/openocd/Config.in
```kconfig
config BR2_PACKAGE_OPENOCD
	bool "openocd"
	depends on BR2_TOOLCHAIN_HAS_THREADS # libusb
	help
	  OpenOCD - Open On-Chip Debugger

	  http://openocd.sourceforge.net/

if BR2_PACKAGE_OPENOCD

comment "Adapters"

config BR2_PACKAGE_OPENOCD_FTDI
	bool "MPSSE mode of FTDI based devices"
	select BR2_PACKAGE_LIBUSB
	help
	  Enable building support for the MPSSE mode of FTDI
	  (FT2xxx/FT4xxx) based devices (default is auto)
      
config BR2_PACKAGE_OPENOCD_STLINK
	bool "ST-Link JTAG Programmer"
	select BR2_PACKAGE_LIBUSB
	help
	  Enable building support for the ST-Link JTAG
	  Programmer (default is auto)
      
config BR2_PACKAGE_OPENOCD_TI_ICDI
	bool "TI ICDI JTAG Programmer"
	select BR2_PACKAGE_LIBUSB
	help
	  Enable building support for the TI ICDI JTAG
	  Programmer (default is auto)
      
config BR2_PACKAGE_OPENOCD_ULINK
	bool "Keil ULINK JTAG Programmer"
	select BR2_PACKAGE_LIBUSB
	help
	  Enable building support for the Keil ULINK JTAG
	  Programmer (default is auto)
      
config BR2_PACKAGE_OPENOCD_UBLASTER2
	bool "Altera USB-Blaster II Compatible"
	select BR2_PACKAGE_LIBUSB
	help
	  Enable building support for the Altera USB-Blaster
	  II Compatible (default is auto)
      
config BR2_PACKAGE_OPENOCD_JLINK
	bool "Segger J-Link JTAG Programmer"
	select BR2_PACKAGE_LIBUSB
	help
	  Segger J-Link JTAG Programmer and clone such as Atmel SAM-ICE

config BR2_PACKAGE_OPENOCD_OSDBM
	bool "OSDBM JTAG (only) Programmer"
	select BR2_PACKAGE_LIBUSB
	help
	  Enable building support for the OSBDM (JTAG only)
	  Programmer (default is auto)
      
config BR2_PACKAGE_OPENOCD_OPENDOUS
	bool "eStick/opendous JTAG Programmer"
	select BR2_PACKAGE_LIBUSB
	help
	  Enable building support for the eStick/opendous JTAG
	  Programmer (default is auto)
      
config BR2_PACKAGE_OPENOCD_AICE
	bool "Andes JTAG Programmer"
	select BR2_PACKAGE_LIBUSB
	help
	  Enable building support for the Andes JTAG
	  Programmer (default is auto)
      
config BR2_PACKAGE_OPENOCD_VSLLINK
	bool "Versaloon-Link JTAG Programmer"
	select BR2_PACKAGE_LIBUSB_COMPAT
	help
	  Enable building support for the Versaloon-Link JTAG
	  Programmer (default is auto)
      
config BR2_PACKAGE_OPENOCD_USBPROG
	bool "USBProg JTAG Programmer"
	select BR2_PACKAGE_LIBUSB_COMPAT
	help
	  Enable building support for the USBProg JTAG
	  Programmer (default is auto)
      
config BR2_PACKAGE_OPENOCD_RLINK
	bool "Raisonance RLink JTAG Programmer"
	select BR2_PACKAGE_LIBUSB_COMPAT
	help
	  Enable building support for the Raisonance RLink
	  JTAG Programmer (default is auto)
      
config BR2_PACKAGE_OPENOCD_ARMEW
	bool "Olimex ARM-JTAG-EW Programmer"
	select BR2_PACKAGE_LIBUSB_COMPAT
	help
	  Enable building support for the Olimex ARM-JTAG-EW
	  Programmer (default is auto)
      
# Removed as it needs hidapi (not actually included in buildroot)
#config BR2_PACKAGE_OPENOCD_CMSIS_DAP
#	bool "CMSIS-DAP Compliant Debugger"
#	select BR2_PACKAGE_LIBUSB
#	select BR2_PACKAGE_LIBHID
#	help
#	  Enable building support for the CMSIS-DAP Compliant
#	  Debugger (default is auto)
      
config BR2_PACKAGE_OPENOCD_PARPORT
	bool "pc parallel port driver"
	help
	  Enable building the pc parallel port driver

config BR2_PACKAGE_OPENOCD_FT2XXX
	bool "FT2232 based devices (DEPRECATED)"
	select BR2_PACKAGE_LIBFTDI
	help
	  (DEPRECATED) Enable building support for FT2232
	  based devices using the libftdi library
      
config BR2_PACKAGE_OPENOCD_VPI
	bool "JTAG VPI"
	help
	  Enable building support for JTAG VPI
	  
config BR2_PACKAGE_OPENOCD_UBLASTER
	bool "Altera USB-Blaster"
	select BR2_PACKAGE_LIBFTDI
	help
	  Enable building support for the Altera USB-Blaster
	  using the libftdi driver, opensource alternate of
	  FTD2XX
      
config BR2_PACKAGE_OPENOCD_AMTJT
	bool "Amontec JTAG-Accelerator"
	help
	  Enable building the Amontec JTAG-Accelerator driver

# zy1000 stuff is actually broken
#config BR2_PACKAGE_OPENOCD_ZY1000_MASTER
#	bool "ZY1000 JTAG master"
#	help
#	  Use ZY1000 JTAG master registers
	  
#config BR2_PACKAGE_OPENOCD_ZY1000
#	bool "ZY1000 interface"
#	help
#	  Enable ZY1000 interface
	  
if BR2_arm

config BR2_PACKAGE_OPENOCD_EP93XX
	bool "EP93xx based SBCs"
	help
	  Enable building support for EP93xx based SBCs
	  
config BR2_PACKAGE_OPENOCD_AT91RM
	bool "AT91RM9200 based SBCs"
	help
	  Enable building support for AT91RM9200 based SBCs
	  
config BR2_PACKAGE_OPENOCD_BCM2835
	bool "bitbanging on BCM2835"
	help
	  Enable building support for bitbanging on BCM2835
	  (as found in Raspberry Pi)

endif # BR2_arm
      
config BR2_PACKAGE_OPENOCD_GW16012
	bool "Gateworks GW16012 JTAG Programmer"
	help
	  Enable building support for the Gateworks GW16012
	  JTAG Programmer
      
config BR2_PACKAGE_OPENOCD_PRESTO
	bool "ASIX Presto Programmer"
	select BR2_PACKAGE_LIBFTDI
	help
	  Enable building support for ASIX Presto Programmer
	  using the libftdi driver
      
config BR2_PACKAGE_OPENOCD_OPENJTAG
	bool "OpenJTAG Programmer"
	select BR2_PACKAGE_LIBFTDI
	help
	  Enable building support for the OpenJTAG Programmer
	  with ftdi driver
      
config BR2_PACKAGE_OPENOCD_BUSPIRATE
	bool "Buspirate"
	help
	  Enable building support for the Buspirate
	  
config BR2_PACKAGE_OPENOCD_SYSFS
	bool "programming via sysfs gpios"
	help
	  Enable building support for programming driven via
	  sysfs gpios.
      
endif # BR2_PACKAGE_OPENOCD

comment "openocd needs a toolchain w/ threads"
	depends on !BR2_TOOLCHAIN_HAS_THREADS
```

## package/openssl/Config.in
```kconfig
config BR2_PACKAGE_OPENSSL_FORCE_LIBOPENSSL
	bool

config BR2_PACKAGE_OPENSSL
	bool "openssl support"
	select BR2_PACKAGE_HAS_OPENSSL
	help
	  Select the desired ssl library provider.

if BR2_PACKAGE_OPENSSL

choice
	prompt "ssl library"
	default BR2_PACKAGE_LIBOPENSSL
	help
	  Select OpenSSL or LibreSSL.

config BR2_PACKAGE_LIBOPENSSL
	bool "openssl"
	select BR2_PACKAGE_ZLIB
	help
	  A collaborative effort to develop a robust, commercial-grade,
	  fully featured, and Open Source toolkit implementing the
	  Secure Sockets Layer (SSL v2/v3) and Transport Security
	  (TLS v1) as well as a full-strength general-purpose
	  cryptography library.

	  http://www.openssl.org/

	  Note: Some helper scripts need perl.

if BR2_PACKAGE_LIBOPENSSL

choice
	prompt "openssl version"
	default BR2_LIBOPENSSL_VERSION_1_0
	help
	  Select the version of libopenssl you wish to use.

config BR2_LIBOPENSSL_VERSION_1_0
	bool "libopenssl 1.0.x"

config BR2_LIBOPENSSL_VERSION_1_1
	bool "libopenssl 1.1.x"

endchoice

config BR2_PACKAGE_LIBOPENSSL_BIN
	bool "openssl binary"
	help
	  Install the openssl binary and the associated helper scripts
	  to the target file system. This is a command line tool for
	  doing various cryptographic stuff.

config BR2_PACKAGE_LIBOPENSSL_ENGINES
	bool "openssl additional engines"
	help
	  Install additional encryption engine libraries.

config BR2_LIBOPENSSL_VERSION
	string
	default "1.0.2n"	if BR2_LIBOPENSSL_VERSION_1_0
	default "1.1.0g"	if BR2_LIBOPENSSL_VERSION_1_1

endif

config BR2_PACKAGE_LIBRESSL
	bool "libressl"
	depends on !BR2_PACKAGE_OPENSSL_FORCE_LIBOPENSSL
	# uClibc on noMMU doesn't provide __register_atfork()
	depends on !(BR2_TOOLCHAIN_USES_UCLIBC && !BR2_USE_MMU)
	help
	  LibreSSL is a version of the TLS/crypto stack forked from
	  OpenSSL in 2014, with goals of modernizing the codebase,
	  improving security, and applying best practice development
	  processes.

	  http://www.libressl.org/

if BR2_PACKAGE_LIBRESSL

config BR2_PACKAGE_LIBRESSL_BIN
	bool "openssl binary"
	help
	  Install the openssl binary to the target file system. This is
	  a command line tool for doing various cryptographic stuff.

endif

endchoice

config BR2_PACKAGE_HAS_OPENSSL
	bool

config BR2_PACKAGE_PROVIDES_OPENSSL
	string
	default "libopenssl"  if BR2_PACKAGE_LIBOPENSSL
	default "libressl"  if BR2_PACKAGE_LIBRESSL

endif

# ensure libopenssl is used for the host variant
config BR2_PACKAGE_PROVIDES_HOST_OPENSSL
	string
	default "host-libopenssl"
```
