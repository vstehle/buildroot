## package/palo/Config.in
```kconfig
config BR2_PACKAGE_PALO
	bool "palo"
	help
	  Palo is the PA-RISC Linux kernel loader.

	  http://www.tldp.org/HOWTO/PA-RISC-Linux-Boot-HOWTO/palo.html
```

## package/ragel/Config.in.host
```kconfig
config BR2_PACKAGE_HOST_RAGEL
	bool "host ragel"
	select BR2_PACKAGE_HOST_COLM
	help
	  TODO!
```

## package/riscv-fesvr/Config.in
```kconfig
config BR2_PACKAGE_RISCV_FESVR
	bool "RISC-V fesvr"
	help
	  Target RISC-V fesvr
	  TODO!
```

## package/riscv-fesvr/Config.in.host
```kconfig
config BR2_PACKAGE_HOST_RISCV_FESVR
	bool "host RISC-V fesvr"
	help
	  Host RISC-V fesvr
	  TODO!
```

## package/riscv-isa-sim/Config.in.host
```kconfig
config BR2_PACKAGE_HOST_RISCV_ISA_SIM
	bool "host RISC-V ISA simulator"
	select BR2_PACKAGE_HOST_RISCV_FESVR
	help
	  Host RISC-V ISA simulator (spike)
	  TODO!
```

## package/riscv-linux/Config.in
```kconfig
# Prompt-less option, because this package is not doing anything except
# downloading the riscv sources. The real work is done by a Linux
# extension.
config BR2_PACKAGE_RISCV_LINUX
	bool
	depends on BR2_LINUX_KERNEL
	help
	  Linux RISC-V
	  TODO!

	  This is only the download helper for the kernel patch.
```

## package/tuxpaint/Config.in
```kconfig
config BR2_PACKAGE_TUXPAINT
	bool "tuxpaint"
	depends on BR2_PACKAGE_PANGO
	depends on BR2_PACKAGE_SDL
	depends on BR2_PACKAGE_SDL_IMAGE
	depends on BR2_PACKAGE_SDL_MIXER
	depends on BR2_PACKAGE_SDL_TTF
	select BR2_PACKAGE_FRIBIDI
	select BR2_PACKAGE_LIBPAPER
	select BR2_PACKAGE_TUXPAINT_STAMPS
	help
	  TODO

comment "tuxpaint needs pango, sdl w/ mixer, image, ttf"
	depends on !BR2_PACKAGE_SDL || !BR2_PACKAGE_SDL_MIXER || \
		   !BR2_PACKAGE_SDL_IMAGE || !BR2_PACKAGE_SDL_TTF || \
		   !BR2_PACKAGE_PANGO
```

## package/uftrace/Config.in
```kconfig
config BR2_PACKAGE_UFTRACE
	bool "uftrace"
	depends on BR2_aarch64 || BR2_arm || BR2_x86_64
	depends on !(BR2_arm && BR2_ARM_SOFT_FLOAT)
	depends on BR2_PACKAGE_ELFUTILS
	depends on BR2_TOOLCHAIN_USES_GLIBC
	help
	  A simple function call tracer for user programs.

	  Note that the executable you want to trace should be compiled
	  with -pg or -finstrument-functions option.

	  https://github.com/namhyung/uftrace

comment "uftrace needs a glibc toolchain and elfutils"
	depends on BR2_aarch64 || BR2_arm || BR2_x86_64
	depends on !BR2_PACKAGE_ELFUTILS || !BR2_TOOLCHAIN_USES_GLIBC

comment "uftrace needs a toolchain with hardware floats on ARM"
	depends on BR2_arm && BR2_ARM_SOFT_FLOAT
```

## package/zerofree/Config.in
```kconfig
config BR2_PACKAGE_ZEROFREE
	bool "zerofree"
	select BR2_PACKAGE_E2FSPROGS
	help
	  TODO!
	  https://frippery.org/uml/
```
